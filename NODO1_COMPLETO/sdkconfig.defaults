## NODO2_COMPLETO/sdkconfig.defaults
```kconfig
# Nodo 2 XD-58C - solo pulso
CONFIG_FREERTOS_HZ=1000
CONFIG_LOG_DEFAULT_LEVEL_INFO=y
CONFIG_LOG_MAXIMUM_LEVEL_INFO=y
CONFIG_ESP_MAIN_TASK_STACK_SIZE=4096
# Sin BLE ni power management en esta version
CONFIG_BT_ENABLED=n
CONFIG_PM_ENABLE=n
```
